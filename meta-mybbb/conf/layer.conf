## meta-mybbb/conf/layer.conf
```bitbake
# We have a conf and classes directory, add to BBPATH
BBPATH .= ":${LAYERDIR}"

# We have recipes-* directories, add to BBFILES
BBFILES += "${LAYERDIR}/recipes-*/*/*.bb \
            ${LAYERDIR}/recipes-*/*/*.bbappend"

BBFILE_COLLECTIONS += "meta-mybbb"
BBFILE_PATTERN_meta-mybbb = "^${LAYERDIR}/"
BBFILE_PRIORITY_meta-mybbb = "6"

LAYERDEPENDS_meta-mybbb = "core"
LAYERSERIES_COMPAT_meta-mybbb = "scarthgap"
```
